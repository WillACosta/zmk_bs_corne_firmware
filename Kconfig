## Kconfig
```kconfig
menuconfig ZMK_CUSTOM_STATUS_BLE
	bool "ZMK Custom Status BLE Service"
	default y
	depends on ZMK && ZMK_BLE
	help
	  Enable the custom BLE GATT service to expose keyboard active layer and split connection status.
```

## config/west.yml
```yaml
manifest:
  remotes:
    - name: zmkfirmware
      url-base: https://github.com/zmkfirmware
    - name: willacosta_modules
      url-base: https://github.com/WillACosta

  projects:
    - name: zmk
      remote: zmkfirmware
      revision: main
      import: app/west.yml

    - name: zmk-status-ble-module
      remote: willacosta_modules
      revision: main

  self:
    path: config
```
