## config/west.yml
```yaml
manifest:
  remotes:
    - name: zmkfirmware
      url-base: https://github.com/zmkfirmware
    - name: willACosta
      url-base: https://github.com/WillACosta

  projects:
    - name: zmk
      remote: zmkfirmware
      revision: 4de313367288aad5aeaa1243890e40dc813f7008
      import: app/west.yml

    - name: prospector-zmk-module
      remote: willACosta
      revision: 6104aea8c972ea422dff11a431d3f4c43c02c44d
      path: modules/prospector-zmk-module

  self:
    path: config
```
